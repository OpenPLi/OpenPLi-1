## pli-oe/pli/conf/distro/opendreambox-openpli.conf
```bitbake
include conf/distro/opendreambox.conf
DISTRO = "opendreambox"
DISTRO_NAME = "PLi®"
DISTRO_VERSION = "OpenPLi"

FEED_URIS += "official##http://downloads.pli-images.org/feeds/${DISTRO_VERSION}/${MACHINE}"

SRCDATE = 20090708

PLISVNURL = "svn://openpli.svn.sourceforge.net/svnroot/openpli"
PLISVNPROTO = "https"
PLISVNREV = "HEAD"
PLISVNBRANCH = "trunk"
PLIVERSION = "${@time.strftime('%Y%m%d',time.gmtime())}"

PREFERRED_VERSION_python-native = "2.5.1"
PREFERRED_VERSION_swig-native = "1.3.39"
PREFERRED_VERSION_python = "2.5.1"
PREFERRED_VERSION_busybox = "1.01"

# we need libsigc++-1.2 1.2.5
PREFERRED_VERSION_libsigc++-1.2 = "1.2.5"

PREFERRED_VERSION_autoconf-native = "2.59"
```
